#include <Arduino.h>
#include <U8g2lib.h>
#include <Wire.h>

// --- I²C OLED setup (SSD1306 128x64) ---
U8G2_SSD1306_128X64_NONAME_F_HW_I2C u8g2(U8G2_R0, /* reset=*/ U8X8_PIN_NONE);

//----------------------------------BIT FOR ICONS--------------------------------------------------------------

// ' icon_cctv', 16x16px
const unsigned char epd_bitmap__icon_cctv [] PROGMEM = {
	0xff, 0x7f, 0x01, 0xc0, 0x15, 0xa0, 0x01, 0x90, 0x01, 0x90, 0x01, 0x70, 0xff, 0x1f, 0x08, 0x02, 
	0xf0, 0x01, 0x41, 0x00, 0x43, 0x00, 0x63, 0x00, 0x3f, 0x00, 0x03, 0x00, 0x03, 0x00, 0x01, 0x00
};
// ' icon_traffic', 16x16px
const unsigned char epd_bitmap__icon_traffic [] PROGMEM = {
	0x60, 0x06, 0x98, 0x19, 0x4f, 0xf2, 0x49, 0x92, 0x8a, 0x51, 0x0c, 0x30, 0x8f, 0xf1, 0x49, 0x92, 
	0x4a, 0x52, 0x8c, 0x31, 0x0f, 0xf0, 0x89, 0x91, 0x4a, 0x52, 0x4c, 0x32, 0x98, 0x19, 0x60, 0x06
};
// ' icon_jammer', 16x16px
const unsigned char epd_bitmap__icon_jammer [] PROGMEM = {
	0x08, 0x10, 0x04, 0x20, 0x12, 0x48, 0x8a, 0x51, 0x49, 0x92, 0x45, 0xa2, 0x49, 0x92, 0x4a, 0x52, 
	0x52, 0x4a, 0x44, 0x22, 0x48, 0x12, 0x40, 0x02, 0x40, 0x02, 0x40, 0x02, 0x40, 0x02, 0x80, 0x01
};

// 'icon_battery', 16x16px
const unsigned char epd_bitmap_icon_battery [] PROGMEM = {
	0x00, 0x00, 0x00, 0x00, 0x00, 0x00, 0x00, 0x00, 0xfc, 0x1f, 0x02, 0x20, 0xda, 0x66, 0xda, 0x66, 
	0xda, 0x66, 0x02, 0x20, 0xfc, 0x1f, 0x00, 0x00, 0x00, 0x00, 0x00, 0x00, 0x00, 0x00, 0x00, 0x00
};
// 'icon_dashboard', 16x16px
const unsigned char epd_bitmap_icon_dashboard [] PROGMEM = {
	0xe0, 0x07, 0x18, 0x18, 0x84, 0x24, 0x0a, 0x40, 0x12, 0x50, 0x21, 0x80, 0xc1, 0x81, 0x45, 0xa2, 
	0x41, 0x82, 0x81, 0x81, 0x05, 0xa0, 0x02, 0x40, 0xd2, 0x4b, 0xc4, 0x23, 0x18, 0x18, 0xe0, 0x07
};
// 'icon_fireworks', 16x16px
const unsigned char epd_bitmap_icon_fireworks [] PROGMEM = {
	0x00, 0x00, 0x00, 0x10, 0x00, 0x29, 0x08, 0x10, 0x08, 0x00, 0x36, 0x00, 0x08, 0x08, 0x08, 0x08, 
	0x00, 0x00, 0x00, 0x63, 0x00, 0x00, 0x00, 0x08, 0x20, 0x08, 0x50, 0x00, 0x20, 0x00, 0x00, 0x00
};
// 'icon_gps_speed', 16x16px
const unsigned char epd_bitmap_icon_gps_speed [] PROGMEM = {
	0x00, 0x00, 0xc0, 0x0f, 0x00, 0x10, 0x80, 0x27, 0x00, 0x48, 0x00, 0x53, 0x60, 0x54, 0xe0, 0x54, 
	0xe0, 0x51, 0xe0, 0x43, 0xe0, 0x03, 0x50, 0x00, 0xf8, 0x00, 0x04, 0x01, 0xfe, 0x03, 0x00, 0x00
};
// 'icon_parksensor', 16x16px
const unsigned char epd_bitmap_icon_parksensor [] PROGMEM = {
	0x00, 0x00, 0x00, 0x00, 0x00, 0x00, 0x3f, 0x00, 0x44, 0x00, 0xa4, 0x00, 0x9f, 0x00, 0x00, 0x81, 
	0x30, 0xa1, 0x48, 0xa9, 0x4b, 0xa9, 0x30, 0xa0, 0x00, 0x80, 0x00, 0x00, 0x00, 0x00, 0x00, 0x00
};

const unsigned char* bitmap_icons[8] = {
	epd_bitmap__icon_cctv,
	epd_bitmap__icon_traffic,
	epd_bitmap__icon_jammer,
	epd_bitmap_icon_battery,
	epd_bitmap_icon_dashboard,
	epd_bitmap_icon_fireworks,
	epd_bitmap_icon_gps_speed,
	epd_bitmap_icon_parksensor
};

//----------------------------------BIT FOR SELECT AND SCROLL--------------------------------------------------------------

// ' item_select', 128x21px
const unsigned char epd_bitmap__item_select [] PROGMEM = {
	0xf8, 0xff, 0xff, 0xff, 0xff, 0xff, 0xff, 0xff, 0xff, 0xff, 0xff, 0xff, 0xff, 0xff, 0xff, 0x03, 
	0x04, 0x00, 0x00, 0x00, 0x00, 0x00, 0x00, 0x00, 0x00, 0x00, 0x00, 0x00, 0x00, 0x00, 0x00, 0x04, 
	0x02, 0x00, 0x00, 0x00, 0x00, 0x00, 0x00, 0x00, 0x00, 0x00, 0x00, 0x00, 0x00, 0x00, 0x00, 0x0c, 
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	0xf8, 0xff, 0xff, 0xff, 0xff, 0xff, 0xff, 0xff, 0xff, 0xff, 0xff, 0xff, 0xff, 0xff, 0xff, 0x03
};

// 'scrollbar_background', 8x64px
const unsigned char epd_bitmap_scrollbar_background [] PROGMEM = {
	0x00, 0x40, 0x00, 0x40, 0x00, 0x40, 0x00, 0x40, 0x00, 0x40, 0x00, 0x40, 0x00, 0x40, 0x00, 0x40, 
	0x00, 0x40, 0x00, 0x40, 0x00, 0x40, 0x00, 0x40, 0x00, 0x40, 0x00, 0x40, 0x00, 0x40, 0x00, 0x40, 
	0x00, 0x40, 0x00, 0x40, 0x00, 0x40, 0x00, 0x40, 0x00, 0x40, 0x00, 0x40, 0x00, 0x40, 0x00, 0x40, 
	0x00, 0x40, 0x00, 0x40, 0x00, 0x40, 0x00, 0x40, 0x00, 0x40, 0x00, 0x40, 0x00, 0x40, 0x00, 0x00
};


//----------------------------------DECLARE INPUT/OUTPUT PIN--------------------------------------------------------------
#define TOUCH_UP_PIN 2
#define TOUCH_SELECT_PIN 4
#define TOUCH_DOWN_PIN 18
#define BUZZER_PIN 19

//----------------------------------LIST OF ITEMS YANG GUNA DALAM DISPLAY----------------------------------------------------------
const int NUM_ITEMS = 8;
char menu_items[NUM_ITEMS] [20] = 
{
	{"CCTV Feed"},
	{"Traffic Hack"},
	{"Signal Jammer"},
	{"Bot Nets"},
	{"About"},
	{"Blackout"},
	{"GPS Navigate"},
	{"Tracking Car"}
};

int	item_select = 0;
int	item_previous;
int	item_next;


//----------------------------------VOID SETUP----------------------------------------------------------
void setup() 
{
	u8g2.begin();
	pinMode(TOUCH_UP_PIN, INPUT);
	pinMode(TOUCH_SELECT_PIN, INPUT);
	pinMode(TOUCH_DOWN_PIN, INPUT);
	pinMode(BUZZER_PIN, OUTPUT);
}

//----------------------------------VOID LOOPING----------------------------------------------------------
void loop() 
{
	if (digitalRead(TOUCH_UP_PIN) == HIGH)
	{
		tone(BUZZER_PIN, 2000);
		delay(100);
		noTone(BUZZER_PIN);
		item_select = item_select - 1;
		if (item_select < 0)
		{
			item_select = NUM_ITEMS - 1;
		}
		delay(250); //untuk delaykan time touch
	}

	if (digitalRead(TOUCH_DOWN_PIN) == HIGH)
	{
		tone(BUZZER_PIN, 1500);
		delay(100);
		noTone(BUZZER_PIN);
		item_select = item_select + 1;
		if (item_select >= NUM_ITEMS)
		{
			item_select = 0;
		}
		delay(250); //untuk delaykan time touch
	}

	//----------------------------------FIRST PAGE LAYOUT--------------------------------------------------------------
	item_previous = item_select - 1;
	if (item_previous < 0)
	{
		item_previous = NUM_ITEMS - 1;
	}

	item_next = item_select + 1;
	if (item_next >= NUM_ITEMS)
	{
		item_next = 0;
		delay(250); //untuk delaykan time touch
	}

  u8g2.firstPage();
	do
	{
		//Box selector
		u8g2.drawXBM(0, 22, 128, 21, epd_bitmap__item_select);

		//Previous item
		u8g2.setFont(u8g2_font_7x14_tr);
		u8g2.drawStr(24, 14, menu_items[item_previous]);
		u8g2.drawXBM(4, 2, 16, 16, bitmap_icons[item_previous]);

		//Select item
		u8g2.setFont(u8g2_font_7x14B_tr);
		u8g2.drawStr(24, 36, menu_items[item_select]);
		u8g2.drawXBM(4, 24, 16, 16, bitmap_icons[item_select]);
		
		//Next item
		u8g2.setFont(u8g2_font_7x14_tr);
		u8g2.drawStr(24, 58, menu_items[item_next]);
		u8g2.drawXBM(4, 46, 16, 16, bitmap_icons[item_next]);

		u8g2.drawXBM(120, 0, 8, 64, epd_bitmap_scrollbar_background);

	}while (u8g2.nextPage() );
}